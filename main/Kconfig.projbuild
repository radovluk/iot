## main/Kconfig.projbuild
```kconfig
menu "Example Configuration"

    config ESP_WIFI_SSID
        string "WiFi SSID"
        default "myssid"
        help
            SSID (network name) for the example to connect to.

    config ESP_WIFI_PASSWORD
        string "WiFi Password"
        default "mypassword"
        help
            WiFi password (WPA or WPA2) for the example to use.

    config ESP_MAXIMUM_RETRY
        int "Maximum retry"
        default 5
        help
            Set the Maximum retry to avoid station reconnecting to the AP unlimited when the AP is really inexistent.
			
	config NTP_SERVER
        string "NTP server"
        default "pool.ntp.org"
        help
            Server for Network Time Protocol
			
	config SMTP_SERVER
        string "Mail Server"
        default "smtp.googlemail.com"
        help
            Target domain for the example to connect to.
			
    config SMTP_PORT_NUMBER
        string "Mail port number"
        default "587"
        help
            Mail port number for the example to connect to.

    config SMTP_SENDER_MAIL
        string "Sender email"
        default "sender.email@gmail.com"
        help
            Sender's Email address

    config SMTP_SENDER_PASSWORD
        string "Sender password"
        default "password@123"
        help
            Sender's email password

    config SMTP_RECIPIENT_MAIL
        string "Recipient email"
        default "recipient.email@gmail.com"
        help
            Recipient's email
			
endmenu
```
